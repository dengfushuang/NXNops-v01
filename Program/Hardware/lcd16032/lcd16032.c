#include "lcd16032.h"
#include "delay.h"
/**********************************************************************************************************
*文件名：lcd16032.c
*所在路径：driver/lcd16032.c
*创建时间: 2012-08-011
*功能描述: 放置LM16032液晶屏驱动函数源文件
*作   者 ： 农晓明
*公   司 ： 光隆金宇
**********************************************************************************************************/

extern void  OSTimeDly (unsigned int ticks);

/*************************************************************************************************************
*函数名称：LCD_WriteCmd()
*参   数 ：uint8_t cmd
*返回值  : void
*功能描述：LCD液晶屏写指令函数
**************************************************************************************************************/
void LCD_WriteCmd(uint8_t cmd)
{
	delay_nus(700);
	LCD_RS_CLR;
	LCD_RW_CLR;
	LCD_DATA(cmd);
	delay_nus(100);
	LCD_E_SET;
	delay_nus(100);
	LCD_E_CLR;
}

/*************************************************************************************************************
*函数名称：LCD_WriteData()
*参   数 ：uint8_t Data
*返回值  : void
*功能描述：LCD液晶屏写数据函数
**************************************************************************************************************/
void LCD_WriteData(uint8_t Data)
{
	delay_nus(700);
	LCD_RS_SET;
	LCD_RW_CLR;
	LCD_DATA(Data);
	delay_nus(100);
	LCD_E_SET;
	delay_nus(100);
	LCD_E_CLR;
}
/*************************************************************************************************************
*函数名称：LCD_Init()
*参   数 ：void
*返回值  : void
*功能描述：LCD液晶屏GPIO初始化配置函数，内部调用
**************************************************************************************************************/
void LCD_Init(void)
{    
	OSTimeDly(2);
	LCD_WriteCmd(0x30);           //功能设定
	LCD_WriteCmd(0x30);
	LCD_WriteCmd(0x0e);           //显示画面设置
	LCD_WriteCmd(0x0c);           //画面显示开, 光标关, 光标反白显示
	LCD_WriteCmd(0x01);           //清屏指令
	OSTimeDly(5);
	LCD_WriteCmd(0x06);           //ENTRY MODE
}
/*************************************************************************************************************
*函数名称：LCD_SetCursor()
*参   数 ：uint8_t X,uingt8_t Y   //相对于屏幕显示的XY值
*返回值  : void
*功能描述：LCD液晶屏设置光标位置函数函数，外部调用
**************************************************************************************************************/
void LCD_SetCursor(uint8_t CharY,uint8_t CharX)
{
	uint8_t CharSite;
	CharX=CharX & 0x0f;
	CharY=CharY & 0x0f;
	CharY=CharY<<4;
	CharY=CharY & 0x30;
	CharY=CharY | 0x80;
	CharSite=CharX | CharY;
	LCD_WriteCmd(CharSite);
}
/*************************************************************************************************************
*函数名称：LCD_PutChar()
*参   数 ：uint8_t CharY,uint8_t CharX,uint8_t *ASC_GB  //相对于屏幕显示的XY值
*返回值  : void
*功能描述：LCD液晶屏指定位置输出字符函数，外部调用
**************************************************************************************************************/
void LCD_PutStr(uint8_t CharY,uint8_t CharX, uint8_t *ASC_GB)
{
	LCD_SetCursor(CharY,CharX);
	while(*ASC_GB>0 && (*ASC_GB!='\0') )
	{
		LCD_WriteData(*ASC_GB);
		ASC_GB++;
		
	}
}

/*************************************************************************************************************
*函数名称：LCD_Putline()
*参   数 ：uint8_t CharY,uint8_t CharX,uint8_t *ASC_GB  //相对于屏幕显示的XY值
*返回值  : void
*功能描述：LCD液晶屏指定位置输出一个行(20个字节)字符函数，外部调用
**************************************************************************************************************/
void LCD_Putline(uint8_t CharY,uint8_t CharX, uint8_t *ASC_GB)
{
    uint8_t len=0;
	LCD_SetCursor(CharY,CharX);
	while(*ASC_GB>0 && (*ASC_GB!='\0') )
	{
		LCD_WriteData(*ASC_GB);
		ASC_GB++;
		len++;		
	}
	
	//不够20个字节的补空格
    if(len < 20)
    {
        len=20-len;
        while(len--) { LCD_WriteData(' '); }
    }
}

